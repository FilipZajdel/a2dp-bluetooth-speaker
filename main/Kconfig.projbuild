## main/Kconfig.projbuild
```kconfig
menu "A2DP Example Configuration"

choice A2DP_SINK_OUTPUT
    prompt "A2DP Sink Output"
    default A2DP_SINK_OUTPUT_EXTERNAL_I2S
    help
        Select to use Internal DAC or external I2S driver

config A2DP_SINK_OUTPUT_INTERNAL_DAC
    bool "Internal DAC"
    help
        Select this to use Internal DAC sink output

config A2DP_SINK_OUTPUT_EXTERNAL_I2S
    bool "External I2S Codec"
    help
        Select this to use External I2S sink output

endchoice

config I2S_LRCK_PIN
    int "I2S LRCK (WS) GPIO"
    default 22
    depends on A2DP_SINK_OUTPUT_EXTERNAL_I2S
    help
        GPIO number to use for I2S LRCK(WS) Driver.

config I2S_BCK_PIN
    int "I2S BCK GPIO"
    default 26
    depends on A2DP_SINK_OUTPUT_EXTERNAL_I2S
    help
        GPIO number to use for I2S BCK Driver.

config I2S_DATA_PIN
    int "I2S DATA GPIO"
    default 25
    depends on A2DP_SINK_OUTPUT_EXTERNAL_I2S
    help
        GPIO number to use for I2S Data Driver.

config USE_MEDIA_BUTTONS
    bool "Use buttons to control media streaming"
    default true
    help
        Enable media buttons.

choice
    prompt "Set interrupt type of media buttons"
    depends on USE_MEDIA_BUTTONS
    help
        Set the interrupt type.

    config MEDIA_BUTTONS_INTR_POS_EDGE
        bool "POSITIVE EDGE"

    config MEDIA_BUTTONS_INTR_NEG_EDGE
        bool "NEGATIVE EDGE"

    config MEDIA_BUTTONS_INTR_ANY_EDGE
        bool "ANY EDGE"

    config MEDIA_BUTTONS_INTR_LOW_LEVEL
        bool "LOW LEVEL"

    config MEDIA_BUTTONS_INTR_HIGH_LEVEL
        bool "HIGH LEVEL"
endchoice

config MEDIA_BUTTONS_INTERRUPT_TYPE
    int
    default 1 if MEDIA_BUTTONS_INTR_POS_EDGE
    default 2 if MEDIA_BUTTONS_INTR_NEG_EDGE
    default 3 if MEDIA_BUTTONS_INTR_ANY_EDGE
    default 4 if MEDIA_BUTTONS_INTR_LOW_LEVEL
    default 5 if MEDIA_BUTTONS_INTR_HIGH_LEVEL

config MEDIA_BUTTONS_PULL_DOWN_ENABLE
    int
    default 0
    default 1 if POS_EDGE || ANY_EDGE || HIGH_LEVEL

config MEDIA_BUTTONS_PULL_UP_ENABLE
    int
    default 1
    default 0 if MEDIA_BUTTONS_PULL_DOWN_ENABLE

config MEDIA_BUTTON_NEXT_PIN
    int "NEXT SONG BUTTON GPIO"
    default 34
    depends on USE_MEDIA_BUTTONS
    help
        GPIO number to use as a button for next song.

config MEDIA_BUTTON_PREV_PIN
    int "PREVIOUS SONG BUTTON GPIO"
    default 35
    depends on USE_MEDIA_BUTTONS
    help
        GPIO number to use as a button for previous song.

config MEDIA_VOLUME_UP_PIN
    int "VOLUME UP BUTTON GPIO"
    default 32
    depends on USE_MEDIA_BUTTONS
    help
        GPIO number to use as a button for setting the volume louder.

config MEDIA_VOLUME_DOWN_PIN
    int "VOLUME DOWN BUTTON GPIO"
    default 33
    depends on USE_MEDIA_BUTTONS
    help
        GPIO number to use as a button for setting the volume softer.

config MEDIA_BUTTON_PLAY_PAUSE
    int "PLAY OR PAUSE BUTTON GPIO"
    default 12
    depends on USE_MEDIA_BUTTONS
    help
        GPIO number to use as a button for playing/pausing audio.

endmenu
```
